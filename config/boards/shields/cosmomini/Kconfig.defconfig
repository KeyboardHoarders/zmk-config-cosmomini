## config/boards/shields/cosmomini/Kconfig.defconfig
```kconfig
if SHIELD_COSMOMINI_LEFT

config ZMK_KEYBOARD_NAME
    default "comsomini"

config ZMK_SPLIT_ROLE_CENTRAL
    default y

endif

if SHIELD_COSMOMINI_LEFT || SHIELD_COSMOMINI_RIGHT

config ZMK_SPLIT
    default y
```

## config/boards/shields/cosmomini/Kconfig.shield
```kconfig
config SHIELD_COSMOMINI_LEFT
    def_bool $(shields_list_contains,cosmomini_left)

config SHIELD_COSMOMINI_RIGHT
    def_bool $(shields_list_contains,cosmomini_right)
```
